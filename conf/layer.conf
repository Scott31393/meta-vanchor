## conf/layer.conf
```bitbake
# We have a conf and classes directory, add to BBPATH
BBPATH .= ":${LAYERDIR}"

# We have recipes-* directories, add to BBFILES
BBFILES += "${LAYERDIR}/recipes-*/*/*.bb \
            ${LAYERDIR}/recipes-*/*/*.bbappend"

BBFILE_COLLECTIONS += "meta-vanchor"
BBFILE_PATTERN_meta-vanchor = "^${LAYERDIR}/"
BBFILE_PRIORITY_meta-vanchor = "9"

LAYERDEPENDS_meta-vanchor = "core"
LAYERSERIES_COMPAT_meta-vanchor = "nanbield"
```
